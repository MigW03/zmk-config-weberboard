## boards/shields/weberboard/Kconfig.defconfig
```kconfig
if SHIELD_WEBERBOARD_LEFT

config ZMK_KEYBOARD_NAME
    default "weberboard"

config ZMK_SPLIT_ROLE_CENTRAL
    default y

endif


if SHIELD_WEBERBOARD_LEFT || SHIELD_WEBERBOARD_RIGHT

config ZMK_SPLIT
    default y

endif
```

## boards/shields/weberboard/Kconfig.shield
```kconfig
config SHIELD_WEBERBOARD_LEFT
    def_bool $(shields_list_contains,weberboard_left)

config SHIELD_WEBERBOARD_RIGHT
    def_bool $(shields_list_contains,weberboard_right)
```

## boards/shields/weberboard_left/Kconfig.shield
```kconfig
config SHIELD_WEBERBOARD_LEFT
    def_bool $(shields_list_contains,weberboard_left)
```

## boards/shields/weberboard_right/Kconfig.defconfig
```kconfig
if SHIELD_WEBERBOARD_RIGHT

config ZMK_KEYBOARD_NAME
    default "weberboard"

config ZMK_SPLIT_ROLE_CENTRAL
    default n

config ZMK_SPLIT
    default y

endif
```

## boards/shields/weberboard_right/Kconfig.shield
```kconfig
config SHIELD_WEBERBOARD_RIGHT
    def_bool $(shields_list_contains,weberboard_right)
```
